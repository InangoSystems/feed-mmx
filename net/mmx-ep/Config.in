## net/mmx-ep/Config.in
```kconfig
################################################################################
#
# Config.in
#
# Copyright (c) 2013-2021 Inango Systems LTD.
#
# Author: Inango Systems LTD. <support@inango-systems.com>
# Creation Date: 01 Jan 2013
#
# The author may be reached at support@inango-systems.com
# 
# Redistribution and use in source and binary forms, with or without modification,
# are permitted provided that the following conditions are met:
# 
# 1. Redistributions of source code must retain the above copyright notice,
# this list of conditions and the following disclaimer.
# 
# 2. Redistributions in binary form must reproduce the above copyright notice,
# this list of conditions and the following disclaimer in the documentation
# and/or other materials provided with the distribution.
# 
# Subject to the terms and conditions of this license, each copyright holder
# and contributor hereby grants to those receiving rights under this license
# a perpetual, worldwide, non-exclusive, no-charge, royalty-free, irrevocable
# (except for failure to satisfy the conditions of this license) patent license
# to make, have made, use, offer to sell, sell, import, and otherwise transfer
# this software, where such license applies only to those patent claims, already
# acquired or hereafter acquired, licensable by such copyright holder or contributor
# that are necessarily infringed by:
# 
# (a) their Contribution(s) (the licensed copyrights of copyright holders and
# non-copyrightable additions of contributors, in source or binary form) alone;
# or
# 
# (b) combination of their Contribution(s) with the work of authorship to which
# such Contribution(s) was added by such copyright holder or contributor, if,
# at the time the Contribution is added, such addition causes such combination
# to be necessarily infringed. The patent license shall not apply to any other
# combinations which include the Contribution.
# 
# Except as expressly stated above, no rights or licenses from any copyright
# holder or contributor is granted under this license, whether expressly, by
# implication, estoppel or otherwise.
# 
# DISCLAIMER
# 
# THIS SOFTWARE IS PROVIDED BY THE COPYRIGHT HOLDERS AND CONTRIBUTORS "AS IS"
# AND ANY EXPRESS OR IMPLIED WARRANTIES, INCLUDING, BUT NOT LIMITED TO, THE
# IMPLIED WARRANTIES OF MERCHANTABILITY AND FITNESS FOR A PARTICULAR PURPOSE
# ARE DISCLAIMED. IN NO EVENT SHALL THE COPYRIGHT HOLDERS OR CONTRIBUTORS BE
# LIABLE FOR ANY DIRECT, INDIRECT, INCIDENTAL, SPECIAL, EXEMPLARY, OR CONSEQUENTIAL
# DAMAGES (INCLUDING, BUT NOT LIMITED TO, PROCUREMENT OF SUBSTITUTE GOODS OR
# SERVICES; LOSS OF USE, DATA, OR PROFITS; OR BUSINESS INTERRUPTION) HOWEVER
# CAUSED AND ON ANY THEORY OF LIABILITY, WHETHER IN CONTRACT, STRICT LIABILITY,
# OR TORT (INCLUDING NEGLIGENCE OR OTHERWISE) ARISING IN ANY WAY OUT OF THE
# USE OF THIS SOFTWARE, EVEN IF ADVISED OF THE POSSIBILITY OF SUCH DAMAGE.
# 
# NOTE
# 
# This is part of a management middleware software package called MMX that was developed by Inango Systems Ltd.
# 
# This version of MMX provides web and command-line management interfaces.
# 
# Please contact us at Inango at support@inango-systems.com if you would like to hear more about
# - other management packages, such as SNMP, TR-069 or Netconf
# - how we can extend the data model to support all parts of your system
# - professional sub-contract and customization services
# 
################################################################################


config MMX_EP_EXT_THRESHOLD
        depends on PACKAGE_mmx-ep
        int
        prompt "Threshold"
        default 0
        help
                Threshold value. Set to 0 to disable.

config MMX_EP_EXT_QUERY_TIMEOUT
        depends on PACKAGE_mmx-ep
        int
        prompt "Query timeout (in seconds)"
        default 60
        help
                Query timeout period


config MMX_BE_IPADDR 
        depends on PACKAGE_mmx-ep
        string
        prompt "Backend IP address"
        default "127.0.0.1"
        help
                BackEnd IP address

config EP_MAX_OBJECTS_NUM
        depends on PACKAGE_mmx-ep
        int
        prompt "Max object num"
        default 128
        help
                Max object num

config EP_MAX_PARAMS_PER_OBJECT
        depends on PACKAGE_mmx-ep
        int
        prompt "Max params per object"
        default 48
        help
                Max params per object

config EP_MAX_INDECES_PER_OBJECT
        depends on PACKAGE_mmx-ep
        int
        prompt "Max indeces per object"
        default 4
        help
                Max indeces per object

config EP_SUBST_VALUES_NUMBER
        depends on PACKAGE_mmx-ep
        int
        prompt "Subst values per object"
        default 5
        help
                Subst values per object

config EP_MAX_METHOD_STR_LEN
        depends on PACKAGE_mmx-ep
        int
        prompt "Max method string lenght"
        default 512
        help
                Max method string lenght

config EP_MAX_LEAF_NAME_LEN
        depends on PACKAGE_mmx-ep
        int
        prompt "Max leaf name lenght"
        default 64
        help
                Max leaf name lenght

config EP_MAX_PARAM_TYPE_LEN
        depends on PACKAGE_mmx-ep
        int
        prompt "Max parameter type lenght"
        default 32
        help
                Max parameter type lenght

config EP_MAX_UNITS_STR_LEN
        depends on PACKAGE_mmx-ep
        int
        prompt "Max units string lenght"
        default 32
        help
                Max units string lenght

config EP_MAX_BENAME_STR_LEN
        depends on PACKAGE_mmx-ep
        int
        prompt "Max backend name lenght"
        default 32
        help
                Max backend name lenght

config EP_SQL_REQUEST_BUF_SIZE
        depends on PACKAGE_mmx-ep
        int
        prompt "Max buffer lenght for SQL requests"
        default 2048
        help
                Max buffer lenght for SQL requests

config EP_TP_WORKER_THREADS_NUM
        depends on PACKAGE_mmx-ep
        int
        prompt "Number worker threads"
        default 4
        help
                Number worker threads

config EP_PTHREAD_STACK_SIZE
        depends on PACKAGE_mmx-ep
        int
        prompt "Worker thread stack size"
        default 1048576
        help
                Worker thread stack size

config EP_MAX_INSTANCES_PER_OBJECT
        depends on PACKAGE_mmx-ep
        int
        prompt "Max instances per object"
        default 312
        help
                Number worker threads

config EP_USE_SYSLOG
        depends on PACKAGE_mmx-ep
        bool "EP Syslog output"
```
